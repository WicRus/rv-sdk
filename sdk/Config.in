## sdk/boards/1106/kernel_1106.its
```
/dts-v1/;
/ {
    description = "U-Boot FIT source file for arm";

    images {
      fdt {
          data = /incbin/("kernel.dtb");
          type = "flat_dt";
          arch = "arm";
          compression = "none";
          load = <0xffffff00>;

          hash {
              algo = "sha256";
          };
      };

      kernel {
          data = /incbin/("zImage");
          type = "kernel";
          arch = "arm";
          os = "linux";
          compression = "none";
          entry = <0xffffff01>;
          load = <0xffffff01>;

          hash {
              algo = "sha256";
          };
      };
    };

    configurations {
        default = "conf";

        conf {
            rollback-index = <0x00>;
            fdt = "fdt";
            kernel = "kernel";

            signature {
                algo = "sha256,rsa2048";
                padding = "pss";
                key-name-hint = "dev";
                sign-images = "fdt", "kernel";
            };
        };
    };
};
```

## sdk/configs/1106_sdk_defconfig
```kconfig
# cpu
BR2_arm=y
BR2_cortex_a7=y

BR2_CCACHE=y

BR2_TOOLCHAIN_BUILDROOT_CXX=y

BR2_INIT_NONE=y
BR2_SYSTEM_BIN_SH_NONE=y
# BR2_TARGET_ENABLE_ROOT_LOGIN is not set
# BR2_TARGET_GENERIC_GETTY is not set
# BR2_TARGET_GENERIC_REMOUNT_ROOTFS_RW is not set
# BR2_TARGET_ROOTFS_TAR is not set
# BR2_PACKAGE_BUSYBOX is not set

# SRC OVERIDES
BR2_PACKAGE_OVERRIDE_FILE="$(BR2_EXTERNAL_RV_SDK_PATH)/overrides/1106.mk"

# KERNEL
BR2_LINUX_KERNEL=y
BR2_LINUX_KERNEL_CUSTOM_VERSION=y
BR2_LINUX_KERNEL_CUSTOM_VERSION_VALUE="5.10.160"
BR2_LINUX_KERNEL_XZ=y
BR2_LINUX_KERNEL_USE_CUSTOM_CONFIG=y
BR2_LINUX_KERNEL_CUSTOM_CONFIG_FILE="$(BR2_EXTERNAL_RV_SDK_PATH)/boards/1106/kernel_1106_defconfig"
# KERNEL HEADERS
BR2_KERNEL_HEADERS_AS_KERNEL=y
BR2_PACKAGE_HOST_LINUX_HEADERS_CUSTOM_5_10=y
```

## sdk/configs/1106_sdmmc_defconfig
```kconfig
# cpu
BR2_arm=y
BR2_cortex_a7=y

BR2_CCACHE=y

# prebuild external toolchain
BR2_TOOLCHAIN_EXTERNAL=y
BR2_TOOLCHAIN_EXTERNAL_CUSTOM=y
BR2_TOOLCHAIN_EXTERNAL_DOWNLOAD=y
BR2_TOOLCHAIN_EXTERNAL_URL="file://$(BR2_EXTERNAL_RV_SDK_PATH)/br.out/1106_sdk/images/arm-buildroot-linux-gnueabihf_sdk-buildroot.tar.gz"
BR2_TOOLCHAIN_EXTERNAL_CUSTOM_PREFIX="arm-buildroot-linux-gnueabihf"
BR2_TOOLCHAIN_EXTERNAL_GCC_15=y
BR2_TOOLCHAIN_EXTERNAL_HEADERS_5_10=y
BR2_TOOLCHAIN_EXTERNAL_CUSTOM_GLIBC=y
BR2_TOOLCHAIN_EXTERNAL_CXX=y
# BR2_TOOLCHAIN_EXTERNAL_INET_RPC is not set

# SRC OVERIDES
BR2_PACKAGE_OVERRIDE_FILE="$(BR2_EXTERNAL_RV_SDK_PATH)/overrides/1106.mk"

# KERNEL
BR2_LINUX_KERNEL=y
BR2_LINUX_KERNEL_XZ=y
BR2_LINUX_KERNEL_USE_CUSTOM_CONFIG=y
BR2_LINUX_KERNEL_CUSTOM_CONFIG_FILE="$(BR2_EXTERNAL_RV_SDK_PATH)/boards/1106/kernel_1106_defconfig"
BR2_LINUX_KERNEL_DTS_SUPPORT=y
BR2_LINUX_KERNEL_CUSTOM_DTS_DIR="$(BR2_EXTERNAL_RV_SDK_PATH)/boards/1106/dts"
BR2_LINUX_KERNEL_INTREE_DTS_NAME="br-ext_1106_sdmmc"
BR2_LINUX_KERNEL_APPENDED_DTB=y

# U-BOOT
BR2_TARGET_UBOOT=y
BR2_TARGET_UBOOT_BUILD_SYSTEM_KCONFIG=y
BR2_TARGET_UBOOT_USE_CUSTOM_CONFIG=y
BR2_TARGET_UBOOT_CUSTOM_CONFIG_FILE="$(BR2_EXTERNAL_RV_SDK_PATH)/boards/1106/u-boot_1106.config"
BR2_TARGET_UBOOT_FORMAT_DTB=y
BR2_TARGET_UBOOT_FORMAT_CUSTOM=y
BR2_TARGET_UBOOT_FORMAT_CUSTOM_NAME="u-boot-nodtb.bin"
BR2_TARGET_UBOOT_SPL=y
BR2_TARGET_UBOOT_NEEDS_DTC=y
BR2_TARGET_UBOOT_CUSTOM_DTS_PATH="$(BR2_EXTERNAL_RV_SDK_PATH)/boards/1106/u-boot_1106.dts"
BR2_TARGET_UBOOT_CUSTOM_MAKEOPTS="DEVICE_TREE=u-boot_1106"

BR2_PACKAGE_ROCKCHIP_RKBIN=y
BR2_PACKAGE_ROCKCHIP_RKBIN_TEE_FILENAME="bin/rv11/rv1106_tee_ta_v1.13.bin"
BR2_PACKAGE_ROCKCHIP_RKBIN_TPL_FILENAME="bin/rv11/rv1106_ddr_924MHz_v1.15.bin"
BR2_PACKAGE_ROCKCHIP_RKBIN_BL31_FILENAME="bin/rv11/rv1106_usbplug_v1.09.bin"

BR2_PACKAGE_BUSYBOX_SHOW_OTHERS=y
BR2_PACKAGE_BUSYBOX_CONFIG_FRAGMENT_FILES="$(BR2_EXTERNAL_RV_SDK_PATH)/boards/1106/busybox.fragment"

# BR2_ROOTFS_PRE_BUILD_SCRIPT
# string "Custom scripts to run before commencing the build"
# BR2_ROOTFS_PRE_BUILD_SCRIPT_ARGS

# BR2_ROOTFS_POST_BUILD_SCRIPT
# string "Custom scripts to run before creating filesystem images"
# BR2_ROOTFS_POST_BUILD_SCRIPT_ARGS

# BR2_ROOTFS_POST_FAKEROOT_SCRIPT
# string "Custom scripts to run inside the fakeroot environment"
# BR2_ROOTFS_POST_FAKEROOT_SCRIPT_ARGS

BR2_ROOTFS_POST_IMAGE_SCRIPT="$(BR2_EXTERNAL_RV_SDK_PATH)/boards/1106/post-image_1106_sdmmc.sh"
# string "Custom scripts to run after creating filesystem images"
# BR2_ROOTFS_POST_IMAGE_SCRIPT_ARGS

BR2_ENABLE_LOCALE_WHITELIST="C en_US"
BR2_GENERATE_LOCALE="en_US"

BR2_TARGET_TZ_INFO=y
BR2_TARGET_LOCALTIME="Etc/GMT+12"

BR2_TARGET_GENERIC_GETTY=y
BR2_TARGET_GENERIC_GETTY_PORT="ttyFIQ0"
BR2_TARGET_GENERIC_GETTY_BAUDRATE_KEEP=y
BR2_TARGET_GENERIC_HOSTNAME="xos"
BR2_TARGET_GENERIC_ISSUE="Welcome to xos"
BR2_TARGET_GENERIC_ROOT_PASSWD="123"
BR2_SYSTEM_DHCP="eth0"

# Filesystems
BR2_TARGET_ROOTFS_EXT2=y
BR2_TARGET_ROOTFS_EXT2_4=y
BR2_TARGET_ROOTFS_EXT2_SIZE="250M"
# BR2_TARGET_ROOTFS_TAR is not set
BR2_PACKAGE_MTD=y

# post-image_1106_sdmmc.sh deps
BR2_PACKAGE_HOST_DTC=y
BR2_PACKAGE_HOST_GENIMAGE=y
BR2_PACKAGE_HOST_UBOOT_TOOLS=y
BR2_PACKAGE_HOST_UBOOT_TOOLS_FIT_SUPPORT=y
BR2_PACKAGE_HOST_UBOOT_TOOLS_FIT_SIGNATURE_SUPPORT=y
```

## sdk/configs/1126_sdmmc_defconfig
```kconfig
# cpu
BR2_arm=y
BR2_cortex_a7=y
BR2_ARM_EABIHF=y

BR2_CCACHE=y

# prebuild external toolchain
BR2_TOOLCHAIN_EXTERNAL=y
BR2_TOOLCHAIN_EXTERNAL_CUSTOM=y
BR2_TOOLCHAIN_EXTERNAL_PATH="$(BR2_EXTERNAL_RV_SDK_PATH)/prebuilts/gcc/linux-x86/arm/gcc-arm-8.3-2019.03-x86_64-arm-linux-gnueabihf"
BR2_TOOLCHAIN_EXTERNAL_CUSTOM_PREFIX="arm-linux-gnueabihf"
BR2_TOOLCHAIN_EXTERNAL_GCC_8=y
BR2_TOOLCHAIN_EXTERNAL_HEADERS_4_19=y
BR2_TOOLCHAIN_EXTERNAL_CUSTOM_GLIBC=y
BR2_TOOLCHAIN_EXTERNAL_CXX=y
BR2_TOOLCHAIN_EXTERNAL_FORTRAN=y
BR2_TOOLCHAIN_EXTERNAL_OPENMP=y
BR2_TOOLCHAIN_BUILDROOT_GLIBC=y
BR2_TOOLCHAIN_BUILDROOT_CXX=y

# SRC OVERIDES
BR2_PACKAGE_OVERRIDE_FILE="$(BR2_EXTERNAL_RV_SDK_PATH)/overrides/1126.mk"

# KERNEL
BR2_LINUX_KERNEL=y
BR2_LINUX_KERNEL_XZ=y
BR2_LINUX_KERNEL_USE_CUSTOM_CONFIG=y
BR2_LINUX_KERNEL_CUSTOM_CONFIG_FILE="$(BR2_EXTERNAL_RV_SDK_PATH)/boards/1126/kernel_1126_defconfig"
BR2_LINUX_KERNEL_DTS_SUPPORT=y
BR2_LINUX_KERNEL_CUSTOM_DTS_DIR="$(BR2_EXTERNAL_RV_SDK_PATH)/boards/1126/dts"
BR2_LINUX_KERNEL_INTREE_DTS_NAME="br-ext_1126_sdmmc_minimal"
BR2_LINUX_KERNEL_APPENDED_DTB=y

# U-BOOT
BR2_TARGET_UBOOT=y
BR2_TARGET_UBOOT_BUILD_SYSTEM_KCONFIG=y
BR2_TARGET_UBOOT_USE_CUSTOM_CONFIG=y
BR2_TARGET_UBOOT_CUSTOM_CONFIG_FILE="$(BR2_EXTERNAL_RV_SDK_PATH)/boards/1126/u-boot_1126.config"
BR2_TARGET_UBOOT_FORMAT_DTB=y
BR2_TARGET_UBOOT_FORMAT_CUSTOM=y
BR2_TARGET_UBOOT_FORMAT_CUSTOM_NAME="u-boot-nodtb.bin"
BR2_TARGET_UBOOT_SPL=y
BR2_TARGET_UBOOT_NEEDS_DTC=y
BR2_TARGET_UBOOT_CUSTOM_DTS_PATH="$(BR2_EXTERNAL_RV_SDK_PATH)/boards/1126/u-boot_1126.dts"
BR2_TARGET_UBOOT_CUSTOM_MAKEOPTS="DEVICE_TREE=u-boot_1126"

BR2_PACKAGE_ROCKCHIP_RKBIN=y
BR2_PACKAGE_ROCKCHIP_RKBIN_TEE_FILENAME="bin/rv11/rv1126_tee_ta_v2.15.bin"
BR2_PACKAGE_ROCKCHIP_RKBIN_TPL_FILENAME="bin/rv11/rv1126_ddr_924MHz_v1.13.bin"

# HOOK SCRIPTS

# BR2_ROOTFS_PRE_BUILD_SCRIPT
# string "Custom scripts to run before commencing the build"
# BR2_ROOTFS_PRE_BUILD_SCRIPT_ARGS

# BR2_ROOTFS_POST_BUILD_SCRIPT
# string "Custom scripts to run before creating filesystem images"
# BR2_ROOTFS_POST_BUILD_SCRIPT_ARGS

# BR2_ROOTFS_POST_FAKEROOT_SCRIPT
# string "Custom scripts to run inside the fakeroot environment"
# BR2_ROOTFS_POST_FAKEROOT_SCRIPT_ARGS

BR2_ROOTFS_POST_IMAGE_SCRIPT="$(BR2_EXTERNAL_RV_SDK_PATH)/boards/1126/post-image_1126_sdmmc.sh"
# string "Custom scripts to run after creating filesystem images"
# BR2_ROOTFS_POST_IMAGE_SCRIPT_ARGS

# system
BR2_PACKAGE_BUSYBOX_SHOW_OTHERS=y
BR2_PACKAGE_BUSYBOX_CONFIG_FRAGMENT_FILES="$(BR2_EXTERNAL_RV_SDK_PATH)/boards/1126/busybox.fragment"

BR2_ENABLE_LOCALE_WHITELIST="C en_US"
BR2_GENERATE_LOCALE="en_US"

BR2_TARGET_TZ_INFO=y
BR2_TARGET_LOCALTIME="Etc/GMT+12"

BR2_TARGET_GENERIC_GETTY=y
BR2_TARGET_GENERIC_GETTY_PORT="ttyFIQ0"
BR2_TARGET_GENERIC_GETTY_BAUDRATE_KEEP=y
BR2_TARGET_GENERIC_HOSTNAME="xos"
BR2_TARGET_GENERIC_ISSUE="Welcome to xos"
BR2_TARGET_GENERIC_ROOT_PASSWD="123"
BR2_SYSTEM_DHCP="eth0"

# Filesystems
BR2_TARGET_ROOTFS_EXT2=y
BR2_TARGET_ROOTFS_EXT2_4=y
BR2_TARGET_ROOTFS_EXT2_SIZE="250M"
# BR2_TARGET_ROOTFS_TAR is not set

# post-image_1126_sdmmc.sh deps
BR2_PACKAGE_HOST_DTC=y
BR2_PACKAGE_HOST_GENIMAGE=y
BR2_PACKAGE_HOST_UBOOT_TOOLS=y
BR2_PACKAGE_HOST_UBOOT_TOOLS_FIT_SUPPORT=y
BR2_PACKAGE_HOST_UBOOT_TOOLS_FIT_SIGNATURE_SUPPORT=y
```

## sdk/configs/1126b_spi_nand_defconfig
```kconfig
# cpu
BR2_aarch64=y
BR2_cortex_a53=y

BR2_CCACHE=y

BR2_TOOLCHAIN_BUILDROOT_GLIBC=y
BR2_TOOLCHAIN_BUILDROOT_CXX=y

# SRC OVERIDES
BR2_PACKAGE_OVERRIDE_FILE="$(BR2_EXTERNAL_RV_SDK_PATH)/overrides/1126b.mk"

# KERNEL
BR2_LINUX_KERNEL=y
BR2_LINUX_KERNEL_CUSTOM_VERSION=y
BR2_LINUX_KERNEL_CUSTOM_VERSION_VALUE="6.1.141"
BR2_LINUX_KERNEL_XZ=y
BR2_LINUX_KERNEL_IMAGEGZ=y
BR2_LINUX_KERNEL_USE_CUSTOM_CONFIG=y
BR2_LINUX_KERNEL_CUSTOM_CONFIG_FILE="$(BR2_EXTERNAL_RV_SDK_PATH)/boards/1126b/kernel_1126b_defconfig"
BR2_LINUX_KERNEL_DTS_SUPPORT=y
BR2_LINUX_KERNEL_CUSTOM_DTS_DIR="$(BR2_EXTERNAL_RV_SDK_PATH)/boards/1126b/dts"
BR2_LINUX_KERNEL_INTREE_DTS_NAME="br-ext_1126b_spi-nand_minimal"
BR2_LINUX_KERNEL_APPENDED_DTB=y
# KERNEL HEADERS
BR2_KERNEL_HEADERS_AS_KERNEL=y
BR2_PACKAGE_HOST_LINUX_HEADERS_CUSTOM_6_1=y

# U-BOOT
BR2_TARGET_UBOOT=y
BR2_TARGET_UBOOT_BUILD_SYSTEM_KCONFIG=y
BR2_TARGET_UBOOT_USE_CUSTOM_CONFIG=y
BR2_TARGET_UBOOT_CUSTOM_CONFIG_FILE="$(BR2_EXTERNAL_RV_SDK_PATH)/boards/1126b/u-boot_1126b.config"
BR2_TARGET_UBOOT_FORMAT_DTB=y
BR2_TARGET_UBOOT_FORMAT_CUSTOM=y
BR2_TARGET_UBOOT_FORMAT_CUSTOM_NAME="u-boot-nodtb.bin"
BR2_TARGET_UBOOT_SPL=y
BR2_TARGET_UBOOT_NEEDS_DTC=y
BR2_TARGET_UBOOT_CUSTOM_DTS_PATH="$(BR2_EXTERNAL_RV_SDK_PATH)/boards/1126b/u-boot_1126b.dts"
BR2_TARGET_UBOOT_CUSTOM_MAKEOPTS="DEVICE_TREE=u-boot_1126b"

BR2_PACKAGE_ROCKCHIP_RKBIN_EXT=y
BR2_PACKAGE_ROCKCHIP_RKBIN_EXT_TEE_FILENAME="bin/rv11/rv1126b_bl31_v1.13.elf"
BR2_PACKAGE_ROCKCHIP_RKBIN_EXT_TPL_FILENAME="bin/rv11/rv1126bp_ddr_1056MHz_v1.10.bin"
BR2_PACKAGE_ROCKCHIP_RKBIN_EXT_BL31_FILENAME="bin/rv11/rv1126b_usbplug_v1.03.bin"

BR2_PACKAGE_BUSYBOX_SHOW_OTHERS=y
BR2_PACKAGE_BUSYBOX_CONFIG_FRAGMENT_FILES="$(BR2_EXTERNAL_RV_SDK_PATH)/boards/1126b/busybox.fragment"

# BR2_ROOTFS_PRE_BUILD_SCRIPT
# string "Custom scripts to run before commencing the build"
# BR2_ROOTFS_PRE_BUILD_SCRIPT_ARGS

# BR2_ROOTFS_POST_BUILD_SCRIPT
# string "Custom scripts to run before creating filesystem images"
# BR2_ROOTFS_POST_BUILD_SCRIPT_ARGS

# BR2_ROOTFS_POST_FAKEROOT_SCRIPT
# string "Custom scripts to run inside the fakeroot environment"
# BR2_ROOTFS_POST_FAKEROOT_SCRIPT_ARGS

BR2_ROOTFS_POST_IMAGE_SCRIPT="$(BR2_EXTERNAL_RV_SDK_PATH)/boards/1126b/post-image_1126b_spi-nand.sh"
# string "Custom scripts to run after creating filesystem images"
# BR2_ROOTFS_POST_IMAGE_SCRIPT_ARGS

BR2_ENABLE_LOCALE_WHITELIST="C en_US"
BR2_GENERATE_LOCALE="en_US"

BR2_TARGET_TZ_INFO=y
BR2_TARGET_LOCALTIME="Etc/GMT+12"

BR2_TARGET_GENERIC_GETTY=y
BR2_TARGET_GENERIC_GETTY_PORT="ttyFIQ0"
BR2_TARGET_GENERIC_GETTY_BAUDRATE_KEEP=y
BR2_TARGET_GENERIC_HOSTNAME="xos"
BR2_TARGET_GENERIC_ISSUE="Welcome to xos"
BR2_TARGET_GENERIC_ROOT_PASSWD="123"
BR2_SYSTEM_DHCP="eth0"

# Filesystems
# BR2_TARGET_ROOTFS_TAR is not set
BR2_TARGET_ROOTFS_SQUASHFS=y
BR2_TARGET_ROOTFS_SQUASHFS4_XZ=y
BR2_TARGET_ROOTFS_SQUASHFS_COMP_OPTS="-ef $(BR2_EXTERNAL_RV_SDK_PATH)/boards/1126b/sqfs_exl.lst"
BR2_PACKAGE_MTD=y

# post-image_1126b_spi-nand.sh deps
BR2_PACKAGE_HOST_DTC=y
BR2_PACKAGE_HOST_MTD=y
BR2_PACKAGE_HOST_UBOOT_TOOLS=y
BR2_PACKAGE_HOST_UBOOT_TOOLS_FIT_SUPPORT=y
BR2_PACKAGE_HOST_UBOOT_TOOLS_FIT_SIGNATURE_SUPPORT=y
```

## sdk/package/Config.in
```kconfig
source "$BR2_EXTERNAL_RV_SDK_PATH/package/pkgs/Config.in"
source "$BR2_EXTERNAL_RV_SDK_PATH/package/modules/Config.in"
```

## sdk/package/modules/Config.in
```kconfig
menu "Kernel modules"

source "$BR2_EXTERNAL_RV_SDK_PATH/package/modules/example-module-overlay/Config.in"

endmenu
```

## sdk/package/pkgs/Config.in
```kconfig
menu "rv br ext demo packages"

source "$BR2_EXTERNAL_RV_SDK_PATH/package/pkgs/test/Config.in"
source "$BR2_EXTERNAL_RV_SDK_PATH/package/pkgs/rockchip-rkbin-ext/Config.in"

endmenu
```

## sdk/package/pkgs/rockchip-rkbin-ext/Config.in
```kconfig
config BR2_PACKAGE_ROCKCHIP_RKBIN_EXT
	bool "rockchip-rkbin-ext"
	depends on BR2_arm || BR2_aarch64
	help
	  This package provides Rockchip SoC binary blobs for U-Boot.

if BR2_PACKAGE_ROCKCHIP_RKBIN_EXT

config BR2_PACKAGE_ROCKCHIP_RKBIN_EXT_TPL_FILENAME
	string "Rockchip rkbin tpl file path"
	help
	  Path to the tpl file inside the rkbin repository. The
	  specified file will be copied and used by U-Boot as tpl.

config BR2_PACKAGE_ROCKCHIP_RKBIN_EXT_BL31_FILENAME
	string "Rockchip rkbin bl31 file path"
	help
	  Path to the bl31 file inside the rkbin repository. The
	  specified file will be copied and used by U-Boot as bl31.

config BR2_PACKAGE_ROCKCHIP_RKBIN_EXT_TEE_FILENAME
	string "Rockchip rkbin tee file path"
	help
	  Path to the TEE file inside the rkbin repository. The
	  specified file will be copied and used by U-Boot as TEE.

endif # BR2_PACKAGE_ROCKCHIP_RKBIN_EXT
```

## sdk/package/pkgs/test/Config.in
```kconfig
config BR2_PACKAGE_TEST_PKG
  bool "test-pkg"
  help
    test package plz ignore
```
