// SPDX-License-Identifier: (GPL-2.0+ OR MIT)
/*
 * Copyright (c) 2020 Fuzhou Rockchip Electronics Co., Ltd.
 */

/dts-v1/;
#include "rv1126.dtsi"
#include "rv1126-u-boot.dtsi"
#include <dt-bindings/input/input.h>

/ {
	model = "RV1126 uboot sdmmc br-ext-demo";
	compatible = "rockchip,rv1126-uboot-sdmmc-br-ext-demo", "rockchip,rv1126";
};

&uart2 {
	status = "okay";
};

&saradc {
	status = "disabled";
};

