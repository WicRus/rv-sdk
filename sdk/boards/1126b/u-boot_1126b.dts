// SPDX-License-Identifier: (GPL-2.0+ OR MIT)
/*
 * Copyright (c) 2020 Fuzhou Rockchip Electronics Co., Ltd.
 */

/dts-v1/;
#include "rv1126b.dtsi"
#include "rv1126b-u-boot.dtsi"
#include <dt-bindings/input/input.h>

/ {
	model = "RV1126b uboot br-ext-demo";
	compatible = "rockchip,rv1126b-uboot-br-ext-demo", "rockchip,rv1126";
};

&saradc0 {
	status = "disabled";
};
